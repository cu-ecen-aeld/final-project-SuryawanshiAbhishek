## meta-lcd/conf/layer.conf
```bitbake
# We have a conf and classes directory, add to BBPATH
BBPATH .= ":${LAYERDIR}"

# We have recipes-* directories, add to BBFILES
BBFILES += "${LAYERDIR}/recipes-*/*/*.bb \
            ${LAYERDIR}/recipes-*/*/*.bbappend"

BBFILE_COLLECTIONS += "meta-lcd"
BBFILE_PATTERN_meta-lcd = "^${LAYERDIR}/"
BBFILE_PRIORITY_meta-lcd = "6"

LAYERDEPENDS_meta-lcd = "core"
LAYERSERIES_COMPAT_meta-lcd = "kirkstone"
```

## meta-server/conf/layer.conf
```bitbake
# We have a conf and classes directory, add to BBPATH
BBPATH .= ":${LAYERDIR}"

# We have recipes-* directories, add to BBFILES
BBFILES += "${LAYERDIR}/recipes-*/*/*.bb \
            ${LAYERDIR}/recipes-*/*/*.bbappend"

BBFILE_COLLECTIONS += "meta-server"
BBFILE_PATTERN_meta-server = "^${LAYERDIR}/"
BBFILE_PRIORITY_meta-server = "6"

LAYERDEPENDS_meta-server = "core"
LAYERSERIES_COMPAT_meta-server = "kirkstone"
```
